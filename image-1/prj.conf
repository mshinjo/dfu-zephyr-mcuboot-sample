## CMakeLists.txt
```
# SPDX-License-Identifier: Apache-2.0

cmake_minimum_required(VERSION 3.20.0)

find_package(Zephyr REQUIRED HINTS $ENV{ZEPHYR_BASE})
project(image-1)

target_sources(app PRIVATE src/main.c)
```

## prj.conf
```kconfig
# Copyright (c) 2022 Mirai Shinjo
#
# SPDX-License-Identifier: Apache-2.0

CONFIG_PRINTK=y
CONFIG_BOOTLOADER_MCUBOOT=y
CONFIG_MCUBOOT_SIGNATURE_KEY_FILE="bootloader/mcuboot/root-rsa-2048.pem"
CONFIG_MCUBOOT_GENERATE_CONFIRMED_IMAGE=y
```

## src/main.c
```c
/*
 * Copyright (c) 2022 Mirai Shinjo
 *
 * SPDX-License-Identifier: Apache-2.0
 */

#include <zephyr/kernel.h>

#define IMAGE 1

int main(void)
{
	printk("%s: Hello World!\nThis message is from image-%d!\n", CONFIG_BOARD, IMAGE);
	return 0;
}
```
